## ik/conf/bblayers.conf.sample
```bitbake
# POKY_BBLAYERS_CONF_VERSION is increased each time build/conf/bblayers.conf
# changes incompatibly
POKY_BBLAYERS_CONF_VERSION = "2"

BBPATH = "${TOPDIR}"
BBFILES ?= ""

LAYERS_PATH = "/home/build/layers"

BBLAYERS ?= " \
  ${LAYERS_PATH}/poky \
  ${LAYERS_PATH}/meta-openembedded/meta-oe \
  ${LAYERS_PATH}/meta-openembedded/meta-python \
  ${LAYERS_PATH}/meta-openembedded/meta-initramfs \
  ${LAYERS_PATH}/meta-openembedded/meta-filesystems \
  ${LAYERS_PATH}/meta-openembedded/meta-networking \
  ${LAYERS_PATH}/meta-openembedded/meta-multimedia \
  ${LAYERS_PATH}/meta-qt5 \
  ${LAYERS_PATH}/meta-freescale \
  ${LAYERS_PATH}/ik \
  "
```

## ik/conf/distro/poky-ik.conf
```bitbake
require conf/distro/poky.conf
DISTRO = "poky-ik"
DISTROOVERRIDES = "poky:poky-ik"
#TCLIBC = "musl"
TCLIBC = "glibc"

# Distro config is evaluated after the machine config, so we have to explicitly
# set the kernel provider to override a machine config.
PREFERRED_PROVIDER_virtual/kernel="linux-fslc"

# We can use packagegroup-core-boot
POKY_DEFAULT_EXTRA_RDEPENDS += "packagegroup-core-boot"
# Drop kernel-module-af-packet from RRECOMMENDS
POKY_DEFAULT_EXTRA_RRECOMMENDS = ""

# Replace poky distro_features
IK_DISTRO_FEATURES_BASE=" largefile udev usbgadget usbhost  acl  argp xattr zeroconf ipv4 ipv6 libc-locales libc-locale-code glib gobject-introspection-data ldconfig"
IK_DISTRO_FEATURES_MEDIA=" alsa gstreamer1"
IK_DISTRO_FEATURES_X11=" x11 opengl xcb xinput2 xkb"
#IK_DISTRO_FEATURES_ADDONS=" multiarch xkbcommon-evdev"
#IK_DISTRO_FEATURES_WIFI = "wifi"

DISTRO_FEATURES = "${IK_DISTRO_FEATURES_BASE} \
                   ${IK_DISTRO_FEATURES_MEDIA} \
                   ${IK_DISTRO_FEATURES_X11} \
#                   ${IK_DISTRO_FEATURES_ADDONS} \
#                   ${IK_DISTRO_FEATURES_WIFI} \
                  "

# enable mdev/busybox for init
#VIRTUAL-RUNTIME_dev_manager = "busybox-mdev"
#VIRTUAL-RUNTIME_login_manager = "busybox"
#VIRTUAL-RUNTIME_init_manager = "busybox"
#VIRTUAL-RUNTIME_initscripts = "initscripts"
#VIRTUAL-RUNTIME_keymaps = "keymaps"
#DISTRO_FEATURES_BACKFILL_CONSIDERED += "sysvinit"

#IMAGE_FSTYPES = "cpio.gz"

# Drop v86d from qemu dependency list (we support serial)
# Drop grub from meta-intel BSPs
# FIXME: A different mechanism is needed here. We could define -tiny
#        variants of all compatible machines, but that leads to a lot
#        more machine configs to maintain long term.
#MACHINE_ESSENTIAL_EXTRA_RDEPENDS = ""
```

## ik/conf/layer.conf
```bitbake
# We have a conf and classes directory, add to BBPATH
BBPATH .= ":${LAYERDIR}"

# We have recipes-* directories, add to BBFILES
BBFILES += "${LAYERDIR}/recipes-*/*.bb \
            ${LAYERDIR}/recipes-*/*.bbappend"

BBFILE_COLLECTIONS += "ik"
LAYERSERIES_COMPAT_ik = "sumo warrior"
BBFILE_PATTERN_ik = "^${LAYERDIR}/"
BBFILE_PRIORITY_ik = "6"
```

## ik/conf/local.conf.sample
```bitbake
SDKMACHINE ?= "x86_64"
MACHINE ??= "imx53qsb"
DISTRO ?= "poky"
PACKAGE_CLASSES ?= "package_rpm"
USER_CLASSES ?= "buildstats image-mklibs image-prelink"
PATCHRESOLVE = "noop"

DL_DIR = "/home/build/download-warrior"

#
# Disk Space Monitoring during the build
#
# Monitor the disk space during the build. If there is less that 1GB of space or less
# than 100K inodes in any key build location (TMPDIR, DL_DIR, SSTATE_DIR), gracefully
# shutdown the build. If there is less that 100MB or 1K inodes, perform a hard abort
# of the build. The reason for this is that running completely out of space can corrupt
# files and damages the build in ways which may not be easily recoverable.
# It's necesary to monitor /tmp, if there is no space left the build will fail
# with very exotic errors.
BB_DISKMON_DIRS ??= "\
    STOPTASKS,${TMPDIR},1G,100K \
    STOPTASKS,${DL_DIR},1G,100K \
    STOPTASKS,${SSTATE_DIR},1G,100K \
    STOPTASKS,/tmp,100M,100K \
    ABORT,${TMPDIR},100M,1K \
    ABORT,${DL_DIR},100M,1K \
    ABORT,${SSTATE_DIR},100M,1K \
    ABORT,/tmp,10M,1K"
    
CONF_VERSION = "1"

BB_NUMBER_THREADS = "4"
PARALLEL_MAKE = "-j 4"
ACCEPT_FSL_EULA = "1"

# Build mode
BUILD_DEBUG="0"
# Optimization mode
FULL_OPTIMIZATION = "-O2 -pipe ${DEBUG_FLAGS}"
DEBUG_OPTIMIZATION = "-O -fno-omit-frame-pointer ${DEBUG_FLAGS} -pipe"
SELECTED_OPTIMIZATION = "${@d.getVar(['FULL_OPTIMIZATION', 'DEBUG_OPTIMIZATION'][d.getVar('DEBUG_BUILD') == '1'])}"
#LDFLAGS =+ "-pg"
# ---------------------------------------------------------------

# Disable sdl
PACKAGECONFIG_remove_pn-qemu-native = " sdl"
PACKAGECONFIG_remove_pn-nativesdk-qemu = " sdl"
# ---------------------------------------------------------------

PREFERRED_PROVIDER_u-boot-fw-utils = "u-boot-fw-utils"

# Distribution configuration
DISTRO_FEATURES_remove=" sysvinit linuxfb wayland vulkan directfb bluetooth bluez5 irda pcmcia smbfs ptest wifi 3g"
# Locale configuration
DISTRO_FEATURES_LIBC_append=" libc-locales libc-locale-code"
DISTRO_FEATURES_append=" ${DISTRO_FEATURES_LIBC}"
GLIBC_GENERATE_LOCALES = "en_US.UTF-8 ru_RU.UTF-8"
IMAGE_LINGUAS = "en-us ru-ru"
ENABLE_BINARY_LOCALE_GENERATION = "1"
DISTRO_FEATURES_append=" udev gstreamer1 pulseaudio systemd "
# Choose graphic environment:
DISTRO_FEATURES_append = " opengl x11"
DISTRO_FEATURES_append = " glib xcb xinput2 xkb xkbcommon-evdev"
# ---------------------------------------------------------------

# Use systemd for system initialization
DISTRO_FEATURES_append = " systemd"
DISTRO_FEATURES_BACKFILL_CONSIDERED += "sysvinit"
VIRTUAL-RUNTIME_login_manager = "shadow-base"
VIRTUAL-RUNTIME_init_manager = "systemd"
VIRTUAL-RUNTIME_initscripts = "systemd-compat-units"

# Replace busybox
PREFERRED_PROVIDER_virtual/base-utils = "coreutils"
VIRTUAL-RUNTIME_base-utils = "coreutils"
VIRTUAL-RUNTIME_base-utils-hwclock = "util-linux-hwclock"
VIRTUAL-RUNTIME_base-utils-syslog = ""

# ModemManager
PACKAGECONFIG_pn-modemmanager_append=" mbim qmi systemd"
# NetworkManager
PACKAGECONFIG_pn-networkmanager_append=" netconfig ifupdown modemmanager ppp nss dnsmasq dhclient systemd"

# Qt in distribution configuration
PACKAGECONFIG_pn-qtbase_append=" release optimize-size linuxfb gl gles2 widgets udev evdev mtdev sql-sqlite icu freetype fontconfig zlib openssl libpng xcb xkb xkbcommon-evdev"
PACKAGECONFIG_pn-qtbase_append=" journald libinput dbus"
#PACKAGECONFIG_pn-qtbase_append=" cups tslib"
PACKAGECONFIG_pn-qtmultimedia_append = " gstreamer pulseaudio"
# ---------------------------------------------------------------

# Proftpd in distribution configuration
PACKAGECONFIG_pn-proftpd_append = " nls ipv6 openssl shadow largefile getopt auth pcre ctrls acl sendfile ctrls dso"
# ---------------------------------------------------------------

#KERNEL_IMAGETYPE = "uImage"
#KERNEL_IMAGETYPE = "zImage"
```

## ik/conf/machine/imx53ik.conf
```bitbake
#@TYPE: Machine
#@NAME: NXP i.MX53 Quick Start Board
#@SOC: i.MX53
#@DESCRIPTION: Machine configuration for NXP i.MX53 Quick Start Board
#@MAINTAINER: Trevor Woerner <trevor.woerner@linaro.org>

MACHINEOVERRIDES =. "mx5:mx53:"

include conf/machine/include/imx-base.inc
include conf/machine/include/tune-cortexa8.inc

KERNEL_DEVICETREE = ""
PREFERRED_PROVIDER_virtual/kernel ??= "${IMX_DEFAULT_KERNEL}"
#PREFERRED_PROVIDER_virtual/kernel=""
MACHINE_FIRMWARE = ""
MACHINE_FEATURES += ""

PREFERRED_PROVIDER_virtual/xserver = "xserver-xorg"
XSERVER_DRIVER                  = "xf86-video-fbdev"
XSERVER = "xserver-xorg \
           xf86-input-evdev \
           ${XSERVER_DRIVER}"

# Skip kernel modules
MACHINE_EXTRA_RRECOMMENDS = ""

IMAGE_FSTYPES = "ext4 tar.bz2"
```

## ubuntu-yocto-build-16.04/build-x86_64-core-image-ik-x11/conf/bblayers.conf
```bitbake
# POKY_BBLAYERS_CONF_VERSION is increased each time build/conf/bblayers.conf
# changes incompatibly
POKY_BBLAYERS_CONF_VERSION = "2"

BBPATH = "${TOPDIR}"
BBFILES ?= ""

LAYERS_DIR="${HOME}/layers"

BBLAYERS ?= " \
  ${LAYERS_DIR}/internet/poky/meta \
  ${LAYERS_DIR}/internet/poky/meta-poky \
  ${LAYERS_DIR}/internet/poky/meta-yocto-bsp \
  ${LAYERS_DIR}/internet/meta-openembedded/meta-oe \
  ${LAYERS_DIR}/internet/meta-openembedded/meta-python \
  ${LAYERS_DIR}/internet/meta-openembedded/meta-networking \
  ${LAYERS_DIR}/internet/meta-qt5 \
  ${LAYERS_DIR}/internet/meta-freescale \
  ${LAYERS_DIR}/custom/meta-ik \
  "
```

## ubuntu-yocto-build-16.04/build-x86_64-core-image-ik-x11/conf/local.conf
```bitbake
# Distribution image  #######################
#MACHINE = "imx53qsb"
#MACHINE = "qemux86"
MACHINE = "qemux86-64"
SDKMACHINE = "x86_64"
DISTRO = "poky"
USER_CLASSES = "buildstats image-mklibs image-prelink"
PATCHRESOLVE = "noop"

IMAGE_FSTYPES = "wic.vmdk tar.gz"

#PACKAGE_CLASSES = "package_ipk"
#PACKAGE_CLASSES = "package_deb"
#PACKAGE_CLASSES = "package_rpm"

TCLIBC = "glibc"
#TCLIBC = "musl"
#TCLIBC = "newlib"
#TCLIBC = "baremetal"

DL_DIR = "/home/build/downloads-sumo"

# Download and compile threads ################
BB_NUMBER_THREADS = "10"
PARALLEL_MAKE = "-j 4"

# Build Optimization #######################
BUILD_DEBUG="0"
#SELECTED_OPTIMIZATION="-O2 -pipe ${DEBUG_FLAGS}"
#SELECTED_OPTIMIZATION="-O2 -pipe"
SELECTED_OPTIMIZATION=" -Os -pipe"

# Disable sdl ############################
PACKAGECONFIG_remove_pn-qemu-native = " sdl"
PACKAGECONFIG_remove_pn-nativesdk-qemu = " sdl"

####################################
CONF_VERSION = "1"
ACCEPT_FSL_EULA = "1"
####################################

# Disk Space Monitoring during the build ###########
BB_DISKMON_DIRS ??= "\
    STOPTASKS,${TMPDIR},1G,100K \
    STOPTASKS,${DL_DIR},1G,100K \
    STOPTASKS,${SSTATE_DIR},1G,100K \
    STOPTASKS,/tmp,100M,100K \
    ABORT,${TMPDIR},100M,1K \
    ABORT,${DL_DIR},100M,1K \
    ABORT,${SSTATE_DIR},100M,1K \
    ABORT,/tmp,10M,1K"
    
# Distribution configuration ###################
DISTRO_FEATURES="${DISTRO_FEATURES_DEFAULT} ${DISTRO_FEATURES_LIBC} ${POKY_DEFAULT_DISTRO_FEATURES} ${DISTRO_FEATURES_LIBC}"
DISTRO_FEATURES_remove = " bluetooth bluez5 irda pcmcia pci nfc"
DISTRO_FEATURES_remove = " wifi nfs"
DISTRO_FEATURES_remove = " pulseaudio wayland vulkan"
DISTRO_FEATURES_append = " glib udev dbus zeroconf 3g alsa sql-sqlite openssl opengl gl x11 xcb xkb xcb-xinput xkbcommon"
DISTRO_FEATURES_append = " opengl gl"

# Use systemd for system initialization
DISTRO_FEATURES_remove = " sysvinit"
DISTRO_FEATURES_append = " systemd"
DISTRO_FEATURES_BACKFILL_CONSIDERED += "sysvinit"
VIRTUAL-RUNTIME_login_manager = "shadow-base"
VIRTUAL-RUNTIME_init_manager = "systemd"
VIRTUAL-RUNTIME_initscripts = "systemd-compat-units"

# Replace busybox
#PREFERRED_PROVIDER_virtual/base-utils = "coreutils"
#VIRTUAL-RUNTIME_base-utils = "coreutils"
#VIRTUAL-RUNTIME_base-utils-hwclock = "util-linux-hwclock"
#VIRTUAL-RUNTIME_base-utils-syslog = ""

# Locale configuration
DISTRO_FEATURES_LIBC_append=" libc-locales libc-locale-code"
DISTRO_FEATURES_append=" ${DISTRO_FEATURES_LIBC}"
GLIBC_GENERATE_LOCALES = "en_US.UTF-8 ru_RU.UTF-8"
IMAGE_LINGUAS = "en-us ru-ru"
# (Useful if the target device has 64Mbytes of RAM or less)
ENABLE_BINARY_LOCALE_GENERATION = "1"

#KERNEL_IMAGETYPE = "uImage"
#KERNEL_IMAGETYPE = "zImage"

# Packages configuration #
# DBus
#PACKAGECONFIG_pn-dbus_remove="  systemd"
PACKAGECONFIG_pn-dbus_append="  systemd"
PACKAGECONFIG_pn-dbus_append="  x11 user-session"
# DBus-glib
PACKAGECONFIG_pn-dbus-glib_remove="  tests"

# Qt Base
PACKAGECONFIG_pn-qtbase_remove=" developer-build qml-debug sm tests examples tools accessibility jpeg ico gtk"
PACKAGECONFIG_pn-qtbase_remove=" mtdev cups journald"
PACKAGECONFIG_pn-qtbase_append=" release optimize-size dbus udev evdev widgets libs freetype glib fontconfig harfbuzz libpng gif zlib pcre sql-sqlite openssl"

PACKAGECONFIG_pn-qtbase_append=" iconv"
PREFERRED_PROVIDER_virtual/libiconv = "glibc"

#PACKAGECONFIG_pn-qtbase_append=" ltcg"

# Qt Base Graphics manager
PACKAGECONFIG_pn-qtbase_remove=" directfb linuxfb kms gbm"
PACKAGECONFIG_pn-qtbase_append=" xcb xkb xkbcommon-evdev"

# Qt Base OpenGL
PACKAGECONFIG_pn-qtbase_remove=" eglfs gl no-opengl"
PACKAGECONFIG_pn-qtbase_append=" gles2"

# Qt Base input
PACKAGECONFIG_pn-qtbase_remove=" tslib libinput"
PACKAGECONFIG_pn-qtbase_append=" xinput2"

# Qt declarative
PACKAGECONFIG_pn-qtdeclarative_remove=" examples tests qtxmlpatterns"
#PACKAGECONFIG_pn-qtdeclarative_append=" "

# Qt SerialPort
PACKAGECONFIG_pn-qtserialport_remove=" examples tests"
#PACKAGECONFIG_pn-qtserialport_append=" "
    
# Qt Multimedia
PACKAGECONFIG_pn-qtmultimedia_remove=" pulseaudio openal"
PACKAGECONFIG_pn-qtmultimedia_append=" alsa gstreamer"

# Proftpd
PACKAGECONFIG_pn-proftpd_remove=" acl cap ctrls curses dso getopt nls pam pcre sendfile sia"
PACKAGECONFIG_pn-proftpd_append = " auth shadow ipv6 largefile openssl strip"
```
